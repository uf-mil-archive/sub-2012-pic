<div class="sideBar"> 
	<div class="sideBox"> 
		<ul class="menu">
			<li class="main selected home"><span class="itemContent"><img src="images/menuicons/info.png" alt="Status" width="32" height="32" style="padding-right: 14px; padding-top: 10px;"/>Home/Status</span></li>
			<li class="main"><a class="itemContent" href="config.htm"><img src="images/menuicons/config.png" alt="Configuration" width="32" height="32"/>Configuration</a></li>
			<li class="main"><a class="itemContent" href="calibration.htm"><img src="images/menuicons/calibrate.png" alt="Calibration" width="32" height="32"/>Calibration</a></li>
			<li class="main"><a class="itemContent" href="support.htm"><img src="images/menuicons/help.png" alt="Support &amp; FAQ" width="32" height="32"/>Support &amp; FAQ</a></li>
		</ul> 
	</div>	
</div> 
